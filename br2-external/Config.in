## br2-external/Config.in
```kconfig
menu "qbtOS packages"

source "$BR2_EXTERNAL_QBTOS_PATH/package/qbittorrent/Config.in"
source "$BR2_EXTERNAL_QBTOS_PATH/package/argon40-rust/Config.in"
source "$BR2_EXTERNAL_QBTOS_PATH/package/qbtos-ca/Config.in"
source "$BR2_EXTERNAL_QBTOS_PATH/package/qbtos-manager/Config.in"

endmenu
```

## br2-external/configs/qbtos_qemu_amd64_defconfig
```kconfig
BR2_x86_64=y
BR2_TOOLCHAIN_EXTERNAL=y
BR2_TOOLCHAIN_EXTERNAL_BOOTLIN=y
BR2_TOOLCHAIN_EXTERNAL_BOOTLIN_X86_64_GLIBC_STABLE=y
BR2_TOOLCHAIN_EXTERNAL_CXX=y
BR2_ENABLE_LOCALE=y
BR2_USE_WCHAR=y
BR2_GLOBAL_PATCH_DIR="board/qemu/patches"
BR2_DOWNLOAD_FORCE_CHECK_HASHES=y
BR2_TARGET_GENERIC_HOSTNAME="qbtos"
BR2_TARGET_GENERIC_ISSUE="Welcome to qbtOS QEMU development"
# BR2_TARGET_GENERIC_REMOUNT_ROOTFS_RW is not set
BR2_TARGET_GENERIC_GETTY_PORT="ttyS0"
BR2_TARGET_GENERIC_GETTY_BAUDRATE_115200=y
BR2_SYSTEM_DHCP="eth0"
BR2_ROOTFS_OVERLAY="$(BR2_EXTERNAL_QBTOS_PATH)/board/qbtos/common/rootfs-overlay"
BR2_ROOTFS_POST_BUILD_SCRIPT="$(BR2_EXTERNAL_QBTOS_PATH)/board/qbtos/common/post-build.sh"
BR2_ROOTFS_POST_FAKEROOT_SCRIPT="$(BR2_EXTERNAL_QBTOS_PATH)/board/qbtos/common/post-build.sh"
BR2_ROOTFS_POST_FAKEROOT_SCRIPT_ARGS="--os-release-only"
BR2_ROOTFS_POST_IMAGE_SCRIPT="$(BR2_EXTERNAL_QBTOS_PATH)/board/qbtos/qemu/post-image.sh"
BR2_LINUX_KERNEL=y
BR2_LINUX_KERNEL_CUSTOM_VERSION=y
BR2_LINUX_KERNEL_CUSTOM_VERSION_VALUE="6.18.7"
BR2_LINUX_KERNEL_USE_CUSTOM_CONFIG=y
BR2_LINUX_KERNEL_CUSTOM_CONFIG_FILE="board/qemu/x86_64/linux.config"
BR2_LINUX_KERNEL_CONFIG_FRAGMENT_FILES="$(BR2_EXTERNAL_QBTOS_PATH)/board/qbtos/common/kernel.fragment"
BR2_LINUX_KERNEL_NEEDS_HOST_LIBELF=y
BR2_PACKAGE_BUSYBOX_SHOW_OTHERS=y
BR2_PACKAGE_BUSYBOX_CONFIG_FRAGMENT_FILES="$(BR2_EXTERNAL_QBTOS_PATH)/board/qbtos/common/busybox.fragment"
BR2_PACKAGE_BASH=y
BR2_PACKAGE_CA_CERTIFICATES=y
BR2_PACKAGE_LIBCURL_CURL=y
BR2_PACKAGE_E2FSPROGS=y
BR2_PACKAGE_E2FSPROGS_FSCK=y
BR2_PACKAGE_IPROUTE2=y
BR2_PACKAGE_KMOD=y
BR2_PACKAGE_KMOD_TOOLS=y
BR2_PACKAGE_NFTABLES=y
BR2_PACKAGE_OPENVPN=y
# BR2_PACKAGE_OPENVPN_LZ4 is not set
# BR2_PACKAGE_OPENVPN_LZO is not set
BR2_PACKAGE_OPENSSL=y
BR2_PACKAGE_LIBOPENSSL=y
BR2_PACKAGE_LIBOPENSSL_BIN=y
BR2_PACKAGE_PYTHON3=y
BR2_PACKAGE_PYTHON3_PY_ONLY=y
BR2_PACKAGE_PYTHON3_SSL=y
BR2_PACKAGE_UTIL_LINUX=y
BR2_PACKAGE_UTIL_LINUX_LIBBLKID=y
BR2_PACKAGE_UTIL_LINUX_MOUNT=y
BR2_PACKAGE_UTIL_LINUX_MOUNTPOINT=y
BR2_PACKAGE_WIREGUARD_TOOLS=y
BR2_PACKAGE_QBITTORRENT=y
BR2_PACKAGE_QBTOS_MANAGER=y
BR2_TARGET_ROOTFS_SQUASHFS=y
BR2_TARGET_ROOTFS_SQUASHFS4_XZ=y
# BR2_TARGET_ROOTFS_TAR is not set
BR2_PACKAGE_HOST_E2FSPROGS=y
BR2_PACKAGE_HOST_GENIMAGE=y
BR2_PACKAGE_HOST_QEMU=y
BR2_PACKAGE_HOST_QEMU_SYSTEM_MODE=y
```

## br2-external/configs/qbtos_rpi4_defconfig
```kconfig
BR2_aarch64=y
BR2_cortex_a72=y
BR2_ARM_FPU_VFPV4=y
BR2_TOOLCHAIN_EXTERNAL=y
BR2_TOOLCHAIN_EXTERNAL_BOOTLIN=y
BR2_TOOLCHAIN_EXTERNAL_BOOTLIN_AARCH64_GLIBC_STABLE=y
BR2_TOOLCHAIN_EXTERNAL_CXX=y
BR2_ENABLE_LOCALE=y
BR2_USE_WCHAR=y
BR2_GLOBAL_PATCH_DIR="board/raspberrypi/patches $(BR2_EXTERNAL_QBTOS_PATH)/board/qbtos/rpi4/patches"
BR2_DOWNLOAD_FORCE_CHECK_HASHES=y
BR2_TARGET_GENERIC_HOSTNAME="qbtos"
BR2_TARGET_GENERIC_ISSUE="Welcome to qbtOS development"
# BR2_TARGET_GENERIC_REMOUNT_ROOTFS_RW is not set
BR2_TARGET_GENERIC_GETTY_PORT="ttyAMA0"
BR2_TARGET_GENERIC_GETTY_BAUDRATE_115200=y
BR2_SYSTEM_DHCP="eth0"
BR2_ROOTFS_OVERLAY="$(BR2_EXTERNAL_QBTOS_PATH)/board/qbtos/rpi4/rootfs-overlay"
BR2_ROOTFS_POST_BUILD_SCRIPT="$(BR2_EXTERNAL_QBTOS_PATH)/board/qbtos/rpi4/post-build.sh"
BR2_ROOTFS_POST_IMAGE_SCRIPT="$(BR2_EXTERNAL_QBTOS_PATH)/board/qbtos/rpi4/post-image.sh"
BR2_LINUX_KERNEL=y
BR2_LINUX_KERNEL_CUSTOM_TARBALL=y
BR2_LINUX_KERNEL_CUSTOM_TARBALL_LOCATION="$(call github,raspberrypi,linux,21b410140c47ffab5668399f6f143c7d7b935c8b)/linux-21b410140c47ffab5668399f6f143c7d7b935c8b.tar.gz"
BR2_LINUX_KERNEL_DEFCONFIG="bcm2711"
BR2_LINUX_KERNEL_CONFIG_FRAGMENT_FILES="$(BR2_EXTERNAL_QBTOS_PATH)/board/qbtos/rpi4/kernel.fragment"
BR2_LINUX_KERNEL_DTS_SUPPORT=y
BR2_LINUX_KERNEL_INTREE_DTS_NAME="broadcom/bcm2711-rpi-4-b"
BR2_LINUX_KERNEL_NEEDS_HOST_OPENSSL=y
BR2_PACKAGE_BUSYBOX_SHOW_OTHERS=y
BR2_PACKAGE_BASH=y
BR2_PACKAGE_CA_CERTIFICATES=y
BR2_PACKAGE_E2FSPROGS=y
BR2_PACKAGE_E2FSPROGS_FSCK=y
BR2_PACKAGE_IPROUTE2=y
BR2_PACKAGE_KMOD=y
BR2_PACKAGE_KMOD_TOOLS=y
BR2_PACKAGE_NFTABLES=y
BR2_PACKAGE_OPENVPN=y
# BR2_PACKAGE_OPENVPN_LZ4 is not set
# BR2_PACKAGE_OPENVPN_LZO is not set
BR2_PACKAGE_OPENSSL=y
BR2_PACKAGE_LIBOPENSSL=y
BR2_PACKAGE_LIBOPENSSL_BIN=y
BR2_PACKAGE_PYTHON3=y
BR2_PACKAGE_PYTHON3_PY_ONLY=y
BR2_PACKAGE_PYTHON3_SSL=y
BR2_PACKAGE_UTIL_LINUX=y
BR2_PACKAGE_UTIL_LINUX_LIBBLKID=y
BR2_PACKAGE_UTIL_LINUX_MOUNT=y
BR2_PACKAGE_UTIL_LINUX_MOUNTPOINT=y
BR2_PACKAGE_WIREGUARD_TOOLS=y
BR2_PACKAGE_QBITTORRENT=y
BR2_PACKAGE_QBTOS_MANAGER=y
BR2_PACKAGE_RPI_FIRMWARE=y
BR2_PACKAGE_RPI_FIRMWARE_VARIANT_PI4=y
BR2_PACKAGE_RPI_FIRMWARE_CONFIG_FILE="$(BR2_EXTERNAL_QBTOS_PATH)/board/qbtos/rpi4/config.txt"
BR2_TARGET_ROOTFS_SQUASHFS=y
BR2_TARGET_ROOTFS_SQUASHFS4_XZ=y
# BR2_TARGET_ROOTFS_TAR is not set
BR2_PACKAGE_HOST_DOSFSTOOLS=y
BR2_PACKAGE_HOST_E2FSPROGS=y
BR2_PACKAGE_HOST_GENIMAGE=y
BR2_PACKAGE_HOST_KMOD_XZ=y
BR2_PACKAGE_HOST_MTOOLS=y
```

## br2-external/package/argon40-rust/Config.in
```kconfig
config BR2_PACKAGE_ARGON40_RUST
	bool "Argon40 case service (Rust)"
	depends on BR2_aarch64
	depends on BR2_PACKAGE_HOST_RUSTC_TARGET_ARCH_SUPPORTS
	select BR2_PACKAGE_HOST_RUSTC
	help
	  Pure-Rust fan, power-button, OLED, and RTC service for
	  Argon40 Raspberry Pi cases. qbtOS pins the source as a Git
	  submodule and builds the same revision with Buildroot Cargo.

	  https://pubcode.archuser.org/firebadnofire/Argon40case-Rust

comment "argon40-rust needs a Rust-supported aarch64 toolchain"
	depends on BR2_aarch64
	depends on !BR2_PACKAGE_HOST_RUSTC_TARGET_ARCH_SUPPORTS
```

## br2-external/package/qbittorrent/Config.in
```kconfig
config BR2_PACKAGE_QBITTORRENT
	bool "qBittorrent-nox"
	depends on BR2_INSTALL_LIBSTDCPP
	depends on BR2_TOOLCHAIN_HAS_THREADS
	depends on BR2_USE_WCHAR
	depends on !BR2_STATIC_LIBS
	select BR2_PACKAGE_BOOST
	select BR2_PACKAGE_BOOST_SYSTEM
	select BR2_PACKAGE_LIBTORRENT_RASTERBAR
	select BR2_PACKAGE_OPENSSL
	select BR2_PACKAGE_QT6
	select BR2_PACKAGE_QT6BASE
	select BR2_PACKAGE_QT6BASE_NETWORK
	select BR2_PACKAGE_QT6BASE_SQL
	select BR2_PACKAGE_QT6BASE_XML
	select BR2_PACKAGE_QT6TOOLS
	select BR2_PACKAGE_HOST_QT6TOOLS_LINGUIST_TOOLS
	select BR2_PACKAGE_ZLIB
	help
	  Build the headless qBittorrent client with its standard Web
	  interface.

comment "qBittorrent needs a toolchain w/ C++, threads, wchar, dynamic library"
	depends on !BR2_INSTALL_LIBSTDCPP || !BR2_TOOLCHAIN_HAS_THREADS || \
		!BR2_USE_WCHAR || BR2_STATIC_LIBS
```

## br2-external/package/qbtos-ca/Config.in
```kconfig
config BR2_PACKAGE_QBTOS_CA
	bool "qbtOS public trust material"
	help
	  Install the qbtOS release-signing certificate hierarchy and
	  immutable RAUC trust anchor. Keep these certificates out of
	  the system-wide TLS trust store.
```

## br2-external/package/qbtos-manager/Config.in
```kconfig
config BR2_PACKAGE_QBTOS_MANAGER
	bool "qbtOS management service"
	depends on BR2_USE_MMU
	depends on BR2_USE_WCHAR
	depends on BR2_TOOLCHAIN_HAS_THREADS
	depends on !BR2_STATIC_LIBS
	select BR2_PACKAGE_IPROUTE2
	select BR2_PACKAGE_GIT
	select BR2_PACKAGE_LIBCURL
	select BR2_PACKAGE_LIBCURL_FORCE_TLS
	select BR2_PACKAGE_LIBOPENSSL_BIN
	select BR2_PACKAGE_NFTABLES
	select BR2_PACKAGE_PYTHON3
	select BR2_PACKAGE_PYTHON3_SSL
	select BR2_PACKAGE_QBTOS_CA
	select BR2_PACKAGE_NFS_UTILS
	select BR2_PACKAGE_NFS_UTILS_NFSV4
	select BR2_PACKAGE_SAMBA4
	help
	  HTTPS setup, status, and fixed-operation control service for
	  qbtOS.

comment "qbtOS manager needs a toolchain w/ threads, wchar, dynamic library"
	depends on !BR2_USE_WCHAR || !BR2_TOOLCHAIN_HAS_THREADS || BR2_STATIC_LIBS
```
